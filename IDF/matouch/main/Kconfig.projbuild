## IDF/matouch/main/Kconfig.projbuild
```kconfig
menu "Makerfabs Project"


choice BOARD_TYPE
    prompt "Board Type"
    default BOARD_TYPE_3_5_IlI9488_FT6236
    help
        Board type. 开发板类型

    config BOARD_TYPE_3_5_IlI9488_FT6236
        bool "3-5-ili9488-ft6236"
        depends on IDF_TARGET_ESP32S3
        select SDCARD_ENABLE
    config BOARD_TYPE_1_28_GC9A01_CST816S
        bool "1-28-gc9a01-cst816s"
        depends on IDF_TARGET_ESP32S3
        select PCF85063A_ENABLE
    config BOARD_TYPE_2_8_ST7798V_GT911
        bool "2-8-st7798v-gt911"
        depends on IDF_TARGET_ESP32S3
    config BOARD_TYPE_4_3_UNKNOWN_GT911
        bool "4-3-unknown-gt911"
        depends on IDF_TARGET_ESP32S3
    config BOARD_TYPE_7_0_UNKNOWN_GT911
        bool "7-0-unknown-gt911"
        depends on IDF_TARGET_ESP32S3
    config BOARD_TYPE_7_0_JD9165_GT911
        bool "7-0-jd9165-gt911"
        depends on IDF_TARGET_ESP32P4
endchoice

if BOARD_TYPE_3_5_IlI9488_FT6236

    choice 3_5_IlI9488_FT6236_INTERFACE_TYPE
    prompt "ILI9488 Interface Type"
    default 3_5_IlI9488_SPI_FT6236
    
    config 3_5_IlI9488_80_FT6236
        bool "8080 Parallel Interface"
        help
            Use 16-bit parallel interface (8080) for ILI9488 display

    config 3_5_IlI9488_SPI_FT6236
        bool "SPI Interface"
        help
            Use SPI interface for ILI9488 display

    endchoice
endif

choice DEVELOPMENT_MODE
    prompt "Development Mode"
    default DEVELOPMENT_MODE_RELEASE
    help
        Development Mode

    config DEVELOPMENT_MODE_DEBUG
        bool "Debug"
    config DEVELOPMENT_MODE_RELEASE
        bool "Release"
endchoice


endmenu
```

## example/esp-idf/lvgl9_demo/components/bsp/Kconfig.projbuild
```kconfig
menu "Board Configuration"

    config SPIFFS_ENABLE
        bool "Enable SPIFFS filesystem support"
        default n
        help
            Enable SPIFFS filesystem support
    
    config SDCARD_ENABLE
        bool "Enable SD Card support"
        default n
        help
            Enable SD Card support

    config AUDIO_ENABLE
        bool "Enable Audio Codec support"
        default n
        help
            Enable Audio Codec support

    config QMI8658_ENABLE
        bool "Enable QMI8658 Accelerometer support"
        default n
        help
            Enable QMI8658 Accelerometer support

    config PCF85063A_ENABLE
        bool "Enable PCF85063A RTC support"
        default n
        help
            Enable PCF85063A RTC support

endmenu
```

## example/esp-idf/lvgl9_demo/main/Kconfig.projbuild
```kconfig
menu "Makerfabs Project"


choice BOARD_TYPE
    prompt "Board Type"
    default BOARD_TYPE_MATOUCH_1_8_S3
    help
        Board type.

    config BOARD_TYPE_MATOUCH_2_8_S3
        bool "matouch-2-8-s3"
        depends on IDF_TARGET_ESP32S3
        select AUDIO_ENABLE
    config BOARD_TYPE_MATOUCH_1_8_S3
        bool "matouch-1-8-s3"
        depends on IDF_TARGET_ESP32S3
    config BOARD_TYPE_MATOUCH_3_16_S3
        bool "matouch-3-16-s3"
        depends on IDF_TARGET_ESP32S3
        select QMI8658_ENABLE
        select AUDIO_ENABLE
        select SDCARD_ENABLE
        select PCF85063A_ENABLE
    config BOARD_TYPE_MATOUCH_3_5_SPI_S3
        bool "matouch-3-5-spi-s3"
        depends on IDF_TARGET_ESP32S3
        select SDCARD_ENABLE
    config BOARD_TYPE_MATOUCH_3_5_8080_S3
        bool "matouch-3-5-8080-s3"
        depends on IDF_TARGET_ESP32S3
        select SDCARD_ENABLE
endchoice

choice DEVELOPMENT_MODE
    prompt "Development Mode"
    default DEVELOPMENT_MODE_DEBUG
    help
        Development Mode.

    config DEVELOPMENT_MODE_DEBUG
        bool "Debug"
    config DEVELOPMENT_MODE_RELEASE
        bool "Release"
endchoice


endmenu
```
